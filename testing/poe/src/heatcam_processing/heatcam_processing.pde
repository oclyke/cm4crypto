/*
  Visualizing the Panasonic Grid-EYE Sensor Data using Processing
  By: Nick Poole
  SparkFun Electronics
  Date: January 12th, 2018
  
  MIT License: Permission is hereby granted, free of charge, to any person obtaining a copy of this 
  software and associated documentation files (the "Software"), to deal in the Software without 
  restriction, including without limitation the rights to use, copy, modify, merge, publish, 
  distribute, sublicense, and/or sell copies of the Software, and to permit persons to whom the 
  Software is furnished to do so, subject to the following conditions:

  The above copyright notice and this permission notice shall be included in all copies or 
  substantial portions of the Software.

  THE SOFTWARE IS PROVIDED "AS IS", WITHOUT WARRANTY OF ANY KIND, EXPRESS OR IMPLIED, INCLUDING 
  BUT NOT LIMITED TO THE WARRANTIES OF MERCHANTABILITY, FITNESS FOR A PARTICULAR PURPOSE AND 
  NONINFRINGEMENT. IN NO EVENT SHALL THE AUTHORS OR COPYRIGHT HOLDERS BE LIABLE FOR ANY CLAIM, 
  DAMAGES OR OTHER LIABILITY, WHETHER IN AN ACTION OF CONTRACT, TORT OR OTHERWISE, ARISING FROM, 
  OUT OF OR IN CONNECTION WITH THE SOFTWARE OR THE USE OR OTHER DEALINGS IN THE SOFTWARE.
  
  Feel like supporting our work? Buy a board from SparkFun!
  https://www.sparkfun.com/products/14568
  
  This example is intended as a companion sketch to the Arduino sketch found in the same folder.
  Once the accompanying code is running on your hardware, run this Processing sketch. 
  This Processing sketch will receive the comma separated values generated by the Arduino code and
  use them to generate a thermal image.
  
  Hardware Connections:
  Attach the Qwiic Shield to your Arduino/Photon/ESP32 or other
  Plug the sensor onto the shield
*/

import processing.serial.*;

String myString = null;
Serial myPort;  // The serial port

float[] temps =  {0,0,0,0,0,0,0,0,0,0,0,0,0,0,0,0,0,0,0,0,0,0,0,0,0,0,0,0,0,0,0,0,0,0,0,0,0,0,0,0,0,0,0,0,0,0,0,0,0,0,0,0,0,0,0,0,0,0,0,0,0,0,0,0};
String[] lines;
int index = 0;
int offset = 0;

float min = 7000.0;
float max = -7000.0;

String path = "/Users/owenlyke/subluminal/cm4crypto/testing/poe/results/cmctech/cc-3a5/";
String filename = "heat";

void draw_heatmap(int elapsed_ms, float global_min, float global_max){
  // Prepare variables needed to draw our heatmap
  int x = 0;
  int y = 0;
  int i = 0;
  float min = 7000.0;
  float max = -7000.0;
  float[] min_loc = {0, 0};
  float[] max_loc = {0, 0};
  background(0);   // Clear the screen with a black background
  colorMode(HSB, 360, 100, 100);
  
  // each GridEYE pixel will be represented by a 50px square: 
  // because 50 x 8 = 400, we draw squares until our y location
  // is 400
  while(y < 400){
  
    
    // for each increment in the y direction, draw 8 boxes in the 
    // x direction, creating a 64 pixel matrix
    while(x < 400){
      // before drawing each pixel, set our paintcan color to the 
      // appropriate mapped color value
      if(temps[i] < min){
        min = temps[i];
        min_loc[0] = x;
        min_loc[1] = y;
      }
      if(temps[i] > max){
        max = temps[i];
        max_loc[0] = x;
        max_loc[1] = y;
      }
      
      //float hue = map(temps[i], 30, 110, 240, 360);
      //float hue = map(temps[i], min, max, 240, 360);
      float hue = map(temps[i], global_min, global_max, 240, 360);
      
      fill(hue, 100, 100);
      rect(x,y,50,50);
      x = x + 50;
      i++;
    }
    
    y = y + 50;
    x = 0;
  }
  
  // Add a gaussian blur to the canvas in order to create a rough
  // visual interpolation between pixels.
  filter(BLUR,8); 
  
    
  //textSize(32);
  colorMode(RGB, 255, 255, 255);
  fill(255, 255, 255);
  text("elapsed: " + nf(elapsed_ms/1000.0, 0, 3) + " s", 250, 30); 
  text(nf(min, 0, 2) + " C", min_loc[0] + 25, min_loc[1] + 25); 
  text(nf(max, 0, 2) + " C", max_loc[0] + 25, max_loc[1] + 25); 
  
}

// The statements in the setup() function 
// execute once when the program begins
void setup() {
  size(400, 400);  // Size must be the first statement
  noStroke();
  frameRate(30);
  
  lines = loadStrings(path + filename +  ".json");
  
  
  // find overall min/max temp values
  for (int i = 0; i < lines.length; i++){
    JSONObject obj = parseJSONObject(lines[i]);
    if (obj == null){
     print("bad json... skipping\n");
     return;
    }
    JSONArray pixelz = obj.getJSONArray("pixels");
    if(pixelz == null){
      print("bad pixelz\n");
      return;
    }
    for (int q = 0; q < 64; q++) {
      float temp = pixelz.getFloat(q); 
      if (temp < min){
        min = temp;
      }
      if(temp > max){
        max = temp;
      }
    }
  }
  
}

// The statements in draw() are executed until the 
// program is stopped. Each statement is executed in 
// sequence and after the last line is read, the first 
// line is executed again.
void draw() { 
  int elapsed = 0;
  if(index < lines.length){
    JSONObject obj = parseJSONObject(lines[index]);
    if (obj == null){
     print("bad json... skipping\n");
     return;
    }
    
    int e = obj.getInt("elapsed_ms");
    if(index == 0){
      offset = e;
    }
    
    elapsed = e - offset;
    
    
    JSONArray pixelz = obj.getJSONArray("pixels");
    if(pixelz == null){
      print("bad pixelz\n");
      return;
    }
 
   // extract pixels into temps
    for(int q = 0; q < 64; q++){
      temps[q] = pixelz.getFloat(q);
    }
    
    draw_heatmap(elapsed, min, max);
    saveFrame(path + "/" + filename + "/output/frame_######.png");
    index += 1;
  } else {
    
    print("complete!\n");
    
    println(str(index/(elapsed/1000.0)) + " fps\n");
    while(true){
    }
  }
}
